## uboot/configs/infinix-x6525_defconfig
```kconfig
# Modelled on reeder-s19mps_defconfig with the differences the X6525 needs: its
# own device tree, and no UFS (this board has an eMMC on sdio3 and no UFS
# device), so CMD_UFS/SCSI/UFS/UFS_SPRD_UMS9230 are dropped.
CONFIG_ARM=y
CONFIG_POSITION_INDEPENDENT=y
CONFIG_ARCH_SPRD=y
CONFIG_TEXT_BASE=0x0
CONFIG_DEFAULT_DEVICE_TREE="ums9230-infinix-x6525"
CONFIG_SYS_BOOTM_LEN=0x800000
# CONFIG_EFI_LOADER is not set
# CONFIG_ANDROID_BOOT_IMAGE is not set
CONFIG_BOOTSTD_FULL=y
CONFIG_SD_BOOT=y
CONFIG_OF_BOARD_SETUP=y
# CONFIG_USE_BOOTCOMMAND is not set
CONFIG_ENV_SOURCE_FILE="infinix-x6525"
CONFIG_USE_PREBOOT=y
CONFIG_DEFAULT_FDT_FILE="sprd/ums9230-infinix-x6525.dtb"
CONFIG_LOGLEVEL=8
CONFIG_CONSOLE_FLUSH_ON_NEWLINE=y
# CONFIG_DISPLAY_CPUINFO is not set
# CONFIG_CYCLIC is not set
CONFIG_LAST_STAGE_INIT=y
CONFIG_CMD_UFETCH=y
# CONFIG_CMD_BOOTDEV is not set
# CONFIG_CMD_BOOTMETH is not set
# CONFIG_CMD_LZMADEC is not set
# CONFIG_CMD_UNLZ4 is not set
# CONFIG_CMD_UNZIP is not set
# CONFIG_CMD_BIND is not set
CONFIG_CMD_DM=y
CONFIG_CMD_LSBLK=y
CONFIG_CMD_MMC=y
CONFIG_CMD_SPI=y
CONFIG_CMD_USB_MASS_STORAGE=y
# CONFIG_CMD_MII is not set
# CONFIG_CMD_CLS is not set
# CONFIG_ISO_PARTITION is not set
CONFIG_SYS_RELOC_GD_ENV_ADDR=y
CONFIG_CLK=y
CONFIG_USB_FUNCTION_FASTBOOT=y
CONFIG_FASTBOOT_BUF_ADDR=0xb0000000
CONFIG_FASTBOOT_BUF_SIZE=0x10000000
CONFIG_MMC_BROKEN_CD=y
CONFIG_SYS_MMC_MAX_BLK_COUNT=1024
CONFIG_MMC_SDHCI=y
CONFIG_MMC_SDHCI_ADMA=y
CONFIG_MMC_SDHCI_ADMA_64BIT_V4=y
CONFIG_MMC_SDHCI_SPRD=y
CONFIG_SPECIFY_CONSOLE_INDEX=y
CONFIG_SPRD_SERIAL=y
CONFIG_SYSRESET=y
CONFIG_USB=y
CONFIG_DM_USB_GADGET=y
CONFIG_USB_MUSB_GADGET=y
CONFIG_USB_MUSB_PIO_ONLY=y
CONFIG_USB_GADGET=y
CONFIG_VIDEO=y
CONFIG_VIDEO_FONT_16X32=y
CONFIG_VIDEO_ANSI=y
CONFIG_SYS_WHITE_ON_BLACK=y
CONFIG_VIDEO_SIMPLE=y
CONFIG_CMD_PSTORE=y
CONFIG_CMD_PSTORE_MEM_ADDR=0xfff80000
CONFIG_CMD_PSTORE_MEM_SIZE=0x40000
CONFIG_CMD_PSTORE_RECORD_SIZE=0x8000
CONFIG_CMD_PSTORE_CONSOLE_SIZE=0x8000
CONFIG_CMD_PSTORE_FTRACE_SIZE=0x0
CONFIG_CMD_PSTORE_PMSG_SIZE=0x8000
```
